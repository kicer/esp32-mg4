## sdkconfig.defaults
```kconfig
# 车机 APP 商店注入 —— ESP32-S3 纯 AP 固件
CONFIG_IDF_TARGET="esp32s3"

# Flash: 8MB，分区表见 partitions.csv
CONFIG_ESPTOOLPY_FLASHSIZE_8MB=y
CONFIG_ESPTOOLPY_FLASHMODE_QIO=y
CONFIG_ESPTOOLPY_FLASHFREQ_80M=y
CONFIG_PARTITION_TABLE_CUSTOM=y
CONFIG_PARTITION_TABLE_CUSTOM_FILENAME="partitions.csv"
CONFIG_PARTITION_TABLE_FILENAME="partitions.csv"

# PSRAM: 8MB Octal（AP_3v3）
CONFIG_SPIRAM=y
CONFIG_SPIRAM_MODE_OCT=y
CONFIG_SPIRAM_SPEED_80M=y
CONFIG_SPIRAM_USE_MALLOC=y

CONFIG_ESP_DEFAULT_CPU_FREQ_MHZ_240=y
# 证书链 5KB 解析在 8KB 栈上偏紧，加大
CONFIG_ESP_MAIN_TASK_STACK_SIZE=16384

# Wi-Fi AP
CONFIG_ESP_WIFI_SOFTAP_SUPPORT=y
CONFIG_ESP_WIFI_STATIC_RX_BUFFER_NUM=8
CONFIG_ESP_WIFI_DYNAMIC_RX_BUFFER_NUM=16
CONFIG_ESP_WIFI_TX_BUFFER_TYPE=1
CONFIG_ESP_WIFI_DYNAMIC_TX_BUFFER_NUM=16

# lwIP：后台应用重试频繁，socket 数留够
CONFIG_LWIP_MAX_SOCKETS=16
CONFIG_LWIP_TCP_SND_BUF_DEFAULT=8192
CONFIG_LWIP_TCP_WND_DEFAULT=8192
CONFIG_LWIP_TCP_RECVMBOX_SIZE=16

# TLS 服务端
CONFIG_MBEDTLS_CERTIFICATE_BUNDLE=n
CONFIG_MBEDTLS_SSL_PROTO_TLS1_2=y
# 证书链 5143 字节，收发缓冲必须大于它
CONFIG_MBEDTLS_SSL_IN_CONTENT_LEN=8192
CONFIG_MBEDTLS_SSL_OUT_CONTENT_LEN=8192
CONFIG_MBEDTLS_HARDWARE_AES=y
# 硬件 MPI 在部分握手长度下会让 Finished 校验失败（实测 CDN 域名必挂），改软件实现
# 代价：RSA2048 签名从 ~100ms 变 ~400ms，握手次数少可接受
CONFIG_MBEDTLS_HARDWARE_MPI=n

# 日志
CONFIG_LOG_DEFAULT_LEVEL_INFO=y
CONFIG_LOG_MAXIMUM_LEVEL_DEBUG=y

# 日志走 USB-Serial/JTAG，否则 S3 默认输出到 UART0（没接 USB-TTL 就看不到）
# console 走 USB-Serial/JTAG（choice 只能选一个，不要写 UART_DEFAULT=n）
CONFIG_ESP_CONSOLE_USB_SERIAL_JTAG=y
CONFIG_ESP_CONSOLE_SECONDARY_NONE=y
CONFIG_BOOTLOADER_LOG_LEVEL_INFO=y
CONFIG_ESP_SYSTEM_PANIC_PRINT_REBOOT=y
CONFIG_ESP_SYSTEM_PANIC_PRINT_HALT=n
```
